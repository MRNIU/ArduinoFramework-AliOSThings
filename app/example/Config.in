## app/example/Config.in
```kconfig
config AOS_APP_EXAMPLE
    bool "Builtin Examples"

if AOS_APP_EXAMPLE
choice
    prompt "Select example"

source "app/example/arduino/arduino_base/Config.in"
if AOS_APP_ARDUINO_BASE
    config AOS_BUILD_APP
        default "arduino.arduino_base"
endif

source "app/example/arduino/arduino_eeprom/Config.in"
if AOS_APP_ARDUINO_EEPROM
    config AOS_BUILD_APP
        default "arduino.arduino_eeprom"
endif

source "app/example/arduino/arduino_sd/Config.in"
if AOS_APP_ARDUINO_SD
    config AOS_BUILD_APP
        default "arduino.arduino_sd"
endif

source "app/example/arduino/arduino_lcd/Config.in"
if AOS_APP_ARDUINO_LCD
    config AOS_BUILD_APP
        default "arduino.arduino_lcd"
endif

source "app/example/arduino/arduino_softwareserial/Config.in"
if AOS_APP_ARDUINO_SOFTWARESERIAL
    config AOS_BUILD_APP
        default "arduino.arduino_softwareserial"
endif

source "app/example/arduino/arduino_wire/Config.in"
if AOS_APP_ARDUINO_WIRE
    config AOS_BUILD_APP
        default "arduino.arduino_wire"
endif

endchoice
endif
```

## app/example/arduino/arduino_base/Config.in
```kconfig
config AOS_APP_ARDUINO_BASE
    bool "arduino base"
    select AOS_COMP_CPLUSPLUS
    select AOS_COMP_ARDUINO_FRAMEWORK
    help

if AOS_APP_ARDUINO_BASE
# Configurations for app arduino
endif
```

## app/example/arduino/arduino_eeprom/Config.in
```kconfig
config AOS_APP_ARDUINO_EEPROM
    bool "arduino_eeprom"
    select AOS_COMP_CPLUSPLUS
    select AOS_COMP_ARDUINO_FRAMEWORK
    help

if AOS_APP_ARDUINO_EEPROM
# Configurations for app arduino
endif
```

## app/example/arduino/arduino_lcd/Config.in
```kconfig
config AOS_APP_ARDUINO_LCD
    bool "arduino_lcd"
    select AOS_COMP_CPLUSPLUS
    select AOS_COMP_ARDUINO_FRAMEWORK
    help

if AOS_APP_ARDUINO_LCD
# Configurations for app arduino
endif
```

## app/example/arduino/arduino_sd/Config.in
```kconfig
config AOS_APP_ARDUINO_SD
    bool "arduino_sd"
    select AOS_COMP_CPLUSPLUS
    select AOS_COMP_ARDUINO_FRAMEWORK
    select AOS_COMP_VFS
    select AOS_COMP_FATFS
    help

if AOS_APP_ARDUINO_SD
# Configurations for app arduino
endif
```

## app/example/arduino/arduino_softwareserial/Config.in
```kconfig
config AOS_APP_ARDUINO_SOFTWARESERIAL
    bool "arduino_softwareserial"
    select AOS_COMP_CPLUSPLUS
    select AOS_COMP_ARDUINO_FRAMEWORK
    help

if AOS_APP_ARDUINO_SOFTWARESERIAL
# Configurations for app arduino
endif
```

## app/example/arduino/arduino_wire/Config.in
```kconfig
config AOS_APP_ARDUINO_WIRE
    bool "arduino_wire"
    select AOS_COMP_CPLUSPLUS
    select AOS_COMP_ARDUINO_FRAMEWORK
    help

if AOS_APP_ARDUINO_WIRE
# Configurations for app arduino
endif
```

## middleware/arduino/Config.in
```kconfig
config AOS_COMP_ARDUINO_FRAMEWORK
    bool "arduino_framework"
    select AOS_COMP_CPLUSPLUS
    select AOS_COMP_CLI
    select AOS_COMP_YLOOP
    select AOS_COMP_VFS
    select AOS_COMP_FATFS
    select AOS_COMP_NETMGR
    select AOS_COMP_ATPARSER if ATHOSTAPP_CONFIG_ATPARSER
    select AOS_COMP_ATHOST
    help
        Arduino FrameWork

if AOS_APP_ARDUINO_FRAMEWORK
# Configurations for app arduino

config ATHOSTAPP_CONFIG_ATPARSER
    bool "Support ATParser"
    default y

source "network/nal/athost/Config.in"
endif
```
